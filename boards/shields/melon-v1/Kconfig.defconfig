## boards/shields/melon-v1/Kconfig.defconfig
```kconfig
if SHIELD_MELON_V1_LEFT

config ZMK_KEYBOARD_NAME
    default "Melon V1"

config ZMK_SPLIT_ROLE_CENTRAL
    default y

endif # left

if SHIELD_MELON_V1_LEFT || SHIELD_MELON_V1_RIGHT

config ZMK_SPLIT
    default y

endif # leftright
```

## boards/shields/melon-v1/Kconfig.shield
```kconfig
config SHIELD_MELON_V1_LEFT
    def_bool $(shields_list_contains,melon_v1_left)

config SHIELD_MELON_V1_RIGHT
    def_bool $(shields_list_contains,melon_v1_right)
```
